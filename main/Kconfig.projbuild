## main/Kconfig.projbuild
```kconfig
menu "100W RGBW LED"

    config GPIO_R
        int "Red Channel GPIO number"
        range 0 48
        default 14

    config GPIO_G
        int "Green Channel GPIO number"
        range 0 48
        default 27

    config GPIO_B
        int "Blue Channel GPIO number"
        range 0 48
        default 26

    config GPIO_W
        int "White Channel GPIO number"
        range 0 48
        default 25
#    choice BLINK_LED
#        prompt "Blink LED type"
#        default BLINK_LED_GPIO if IDF_TARGET_ESP32
#        default BLINK_LED_RMT
#        help
#            Defines the default peripheral for blink example
#
#        config BLINK_LED_GPIO
#            bool "GPIO"
#        config BLINK_LED_RMT
#            bool "RMT - Addressable LED"
#    endchoice

#    config BLINK_LED_RMT_CHANNEL
#        depends on BLINK_LED_RMT
#        int "RMT Channel"
#        range 0 7
#        default 0
#        help
#            Set the RMT peripheral channel.
#            ESP32 RMT channel from 0 to 7
#            ESP32-S2 RMT channel from 0 to 3
#            ESP32-S3 RMT channel from 0 to 3
#            ESP32-C3 RMT channel from 0 to 1
#
#    config BLINK_GPIO
#        int "Blink GPIO number"
#        range 0 48
#        default 8 if IDF_TARGET_ESP32C3 || IDF_TARGET_ESP32H2
#        default 18 if IDF_TARGET_ESP32S2
#        default 48 if IDF_TARGET_ESP32S3
#        default 5
#        help
#            GPIO number (IOxx) to blink on and off or the RMT signal for the addressable LED.
#            Some GPIOs are used for other purposes (flash connections, etc.) and cannot be used to blink.
#
#    config BLINK_PERIOD
#        int "Blink period in ms"
#        range 10 3600000
#        default 1000
#        help
#            Define the blinking period in milliseconds.

endmenu
menu "Motor Settings"
    choice MOTOR_TYPE
        prompt "Motor Driver Type"
        default MOTOR_TYPE_L298N
        config MOTOR_TYPE_L298N
            bool "L298N"
        config MOTOR_TYPE_BTS7960
            bool "BTS7960"
    endchoice
    config MOTOR_POS
        depends on MOTOR_TYPE_L298N
        int "Motor GPIO IN1"
        default 21
    config MOTOR_NEG
        depends on MOTOR_TYPE_L298N
        int "Motor GPIO IN2"
        default 22
    config MOTOR_EN
        depends on MOTOR_TYPE_L298N
        int "Motor GPIO PWM"
        default 23
    config MOTOR_EN_R
        depends on MOTOR_TYPE_BTS7960
        int "Motor GPIO Reverse EN"
        default 21
    config MOTOR_EN_F
        depends on MOTOR_TYPE_BTS7960
        int "Motor GPIO EN Forward"
        default 19
    config MOTOR_PWM_F
        depends on MOTOR_TYPE_BTS7960
        int "Motor GPIO PWM Forward"
        default 22
    config MOTOR_PWM_R
        depends on MOTOR_TYPE_BTS7960
        int "Motor GPIO PWM Reverse"
        default 23
    config MOTOR_IS_F
        depends on MOTOR_TYPE_BTS7960
        int "Motor GPIO Current Sense Forward"
        default 35
    config MOTOR_IS_R
        depends on MOTOR_TYPE_BTS7960
        int "Motor GPIO Current Sense Reverse"
        default 34
    config ENC_A
        int "Encoder GPIO A"
        default 27 if MOTOR_TYPE_BTS7960
        default 19 if MOTOR_TYPE_L298N
    config ENC_B
        int "Encoder GPIO B"
        default 26 if MOTOR_TYPE_BTS7960
        default 18 if MOTOR_TYPE_L298N
endmenu

menu "WIFI Settings"

    config WIFI_SSID
        string "AP SSID"
        default "ESP OTA Update"
    config WIFI_PASS
        string "AP pass"
        default "Badger101"
    config STA_SSID
        string "Network SSID"
        default "SS-Net"
    config STA_PASS
        string "Network pass"
        default "Pangolin303"
    config IPV4_ADDR
        string "IPV4 Address"
        default "192.168.8.22"
    config IPV4_GW
        string "IPV4 GW"
        default "192.168.8.1"
    config DOUBLERESET_TIMEOUT
        int "Double Reset Timeout, ms"
        default 10000
endmenu

menu "Logging"
    config LOG_PORT
        int "Log Port"
        range 0 65535
        default 5555
    config LOG_DEST
        string "Log Address"
        default "192.168.8.202"
endmenu

menu "OSC Settings"
    config OSC_PORT
        int "OSC Port"
        range 0 65535
        default 8888
endmenu
```
